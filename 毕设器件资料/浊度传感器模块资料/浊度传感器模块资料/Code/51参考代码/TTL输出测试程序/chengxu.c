/********************(C) COPRIGHT 2019 Crownto electronic **************************
 * 文件名  ：main.c
 * 描述    ：        
 * 硬件连接：
 * 浊度传感器模块: VCC -> 5V; GND -> GND; DO -> P2.0;
 * LED：   LED -> P1.0
 * 功能描述：P2.0口判断浊度传感器模块输出信号；控制指示灯显示当前水位状态
             （LED可改为继电器控制）
 * 淘宝    ：https://ilovemcu.taobao.com
**********************************************************************************/
#include <reg52.h>  	       //库文件
#define uchar unsigned char//宏定义无符号字符型
#define uint unsigned int  //宏定义无符号整型

/********************************************************************
                            I/O定义
*********************************************************************/
sbit LED=P1^0;	 //定义单片机P1口的第1位 （即P1.0）为指示端
sbit DOUT=P2^0;	 //定义单片机P2口的第1位 （即P2.0）为传感器的输入端
/********************************************************************
                            延时函数
*********************************************************************/
void delay()//延时程序
{
uchar m,n,s;
for(m=20;m>0;m--)
for(n=20;n>0;n--)
for(s=248;s>0;s--);
}
/********************************************************************
                            主函数
*********************************************************************/
void main()
{
	LED=1;	   //初始熄灭P1.0口灯
	while(1)   //无限循环
	{
	 if(DOUT==0)//当有水时 
	 {
    	delay();//延时抗干扰
		if(DOUT==0)//当浊度值高于设定阈值时
	    {
		   LED=0;	   //点亮P1.0口灯
		}
	 }
	 else   //当浊度值低于设定阈值时
	 {
	   		 LED=1;	   //熄灭P1.0口灯
	 }
	}
}	
/********************************************************************
                              结束
*********************************************************************/